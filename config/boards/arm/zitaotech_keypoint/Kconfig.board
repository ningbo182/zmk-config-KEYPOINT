## config/boards/arm/zitaotech_keypoint/Kconfig.board
```kconfig
# Copyright (c) 2025 ZitaoTech
# SPDX-License-Identifier: MIT

config BOARD_ZITAOTECH_KEYPOINT_LEFT
    bool "zitaotech keypoint left"
    depends on SOC_NRF52840_QIAA

config BOARD_ZITAOTECH_KEYPOINT_RIGHT
    bool "zitaotech keypoint right"
    depends on SOC_NRF52840_QIAA
```
